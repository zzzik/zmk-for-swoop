## config/boards/shields/swoop/Kconfig.defconfig
```kconfig
# Copyright (c) 2022 Duccio Breschi
# SPDX-License-Identifier: MIT

if SHIELD_SWOOP_LEFT

config ZMK_KEYBOARD_NAME
    default "swoop"

config ZMK_SPLIT_ROLE_CENTRAL
    default y

endif # LEFT

if SHIELD_SWOOP_LEFT || SHIELD_SWOOP_RIGHT

config ZMK_SPLIT
    default y
    
endif # LEFT RIGHT
```
